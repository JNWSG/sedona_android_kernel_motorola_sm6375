## drivers/input/misc/goodix_fod_mmi/Kconfig
```kconfig
config INPUT_GOODIX_FOD_MMI
	tristate "Goodix fingerprint sensor MMI"
	default n
	help
	 Say Y here if you wish to include support for MMI Goodix finger print sensor.
	 If unsure, say N.

config INPUT_MISC_GOODIX_FOD_SOFTDEP
	bool "Goodix FOD softdependency on GPIO_PCAL6408"
	depends on INPUT_GOODIX_FOD_MMI

config INPUT_GOODIX_FOD_MMI_RELAY
	bool "Goodix fingerprint Additional dependencies MMI"
	depends on INPUT_GOODIX_FOD_MMI
	default n
	help
	 Say Y here if you wish to include support for MMI Goodix finger print sensor.
	 If unsure, say N.
```

## drivers/input/misc/rbs_fps_mmi/Kconfig
```kconfig
config INPUT_EGIS_FPS_MMI
	tristate "MMI egistec fingerprint sensor"
	default n
	help
	  Say Y here if you wish to include support for MMI egistec fingerprint sensor.
	  If unsure, say N.

config INPUT_EGIS_ET721_FOD
	bool "FOD Support for MMI egistec fingerprint sensor"
	default n
	depends on INPUT_EGIS_FPS_MMI
	help
	  Say Y here if you wish to include FOD support for MMI egistec fingerprint sensor.
	  If unsure, say N.

config EGIS_PANEL_NOTIFICATIONS
	bool "Panel Notification Support for egis"
	default n
	depends on INPUT_EGIS_FPS_MMI
	help
	 Say Y here if you wish to include support for MMI EGIS finger print sensor
         panel notification framework support.
	 If unsure, say N.
```

## drivers/input/touchscreen/chipone_tddi_v2_mmi/Kconfig
```kconfig
#
# Chipone Touchscreen driver configuration
#

config TOUCHSCREEN_CHIPONE
	tristate "Moto CHIPONE Touchscreen"
	depends on I2C
	default n
	help
	  Say Y here if you have Moto Chipone touch panel.
	  If unsure, say N.

config INPUT_CHIPONE_0FLASH_MMI_ENABLE_DOUBLE_TAP
        tristate "Moto CHIPONE Touchscreen"
        depends on I2C
        default n
        help
          Say Y here if you have Moto Chipone touch panel.
          If unsure, say N.

config INPUT_CHIPONE_0FLASH_MMI_NOTIFY_TOUCH_STATE
        tristate "Moto CHIPONE Touchscreen"
        depends on I2C
        default n
        help
          Say Y here if you have Moto Chipone touch panel.
          If unsure, say N.

config STOWED_MODE_EN
        tristate "Moto CHIPONE Touchscreen"
        depends on I2C
        default n
        help
          Say Y here if you have Moto Chipone touch panel.
          If unsure, say N.

config INPUT_TOUCHSCREEN_MMI
        tristate "Moto CHIPONE Touchscreen"
        depends on I2C
        default n
        help
          Say Y here if you have Moto Chipone touch panel.
          If unsure, say N.

config BOARD_USES_DOUBLE_TAP_CTRL
        tristate "Moto CHIPONE Touchscreen"
        depends on I2C
        default n
        help
          Say Y here if you have Moto Chipone touch panel.
          If unsure, say N.

config INPUT_CHIPONE_PANEL_NOTIFICATIONS
        tristate "Moto CHIPONE Touchscreen"
        depends on I2C
        default n
        help
          Say Y here if you have Moto Chipone touch panel.
          If unsure, say N.

config GTP_LAST_TIME
        tristate "Moto CHIPONE Touchscreen"
        depends on I2C
        default n
        help
          Say Y here if you have Moto Chipone touch panel.
          If unsure, say N.

config CHIPONE_ESD
        tristate "Moto CHIPONE Touchscreen"
        depends on I2C
        default n
        help
          Say Y here if you have Moto Chipone touch panel.
          If unsure, say N.
```
